// SPDX-License-Identifier: BSD-3-Clause
/*
 * Lenovo TB710FU: active pen (Lenovo Tab Pen Plus) through the NT36532 touch
 * IC, as in the vendor dtbo; the driver then registers "NVTCapacitivePen"
 * (pressure, tilt, two buttons) and, with patch 0202, keeps pen scanning on
 * after its boot firmware update; /proc/support_pen still overrides it.
 */

/dts-v1/;
/plugin/;

&spi4 {
	touchscreen@0 {
		novatek,pen-support;
	};
};
